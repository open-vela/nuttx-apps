## examples/uio/Kconfig
```kconfig
#
# For a description of the syntax of this configuration file,
# see the file kconfig-language.txt in the NuttX tools repository.
#

config EXAMPLES_UIO
	tristate "Rpmsg uio example"
	default n
	---help---
		Enable the rpmsg uio test example
```

## interpreters/quickjs/Kconfig
```kconfig
#
# For a description of the syntax of this configuration file,
# see the file kconfig-language.txt in the NuttX tools repository.
#

config INTERPRETERS_QUICKJS
	tristate "QuickJS JavaScript interpreter"
	default n

if INTERPRETERS_QUICKJS

choice
	prompt "QuickJS command line interpreter"
	default INTERPRETERS_QUICKJS_NONE

config INTERPRETERS_QUICKJS_NONE
	bool "distable quickjs interpreter"

config INTERPRETERS_QUICKJS_MINI
	bool "Minimal quickjs interpreter"

config INTERPRETERS_QUICKJS_FULL
	bool "normal quickjs interpreter"

endchoice # QuickJS command line interpreter

config INTERPRETERS_QUICKJS_BIGNUM
	bool "Bignum support"
	default n
	---help---
		It's depend on libatomic,
		Not all platform support it.

config INTERPRETERS_QUICKJS_PRIORITY
	int "QuickJS interpreter priority"
	default 100

config INTERPRETERS_QUICKJS_STACKSIZE
	int "QuickJS interpreter stack size"
	default 8192

config INTERPRETERS_QUICKJS_EXT_HOOK
	bool "External init/destory hook"
	default n
	depends on INTERPRETERS_QUICKJS_MINI
	---help---
		Since minimal interpreter only support 'console.log',
		you can export custom module by implement init/destory hook.

config INTERPRETERS_QUICKJS_DEBUG
	bool "QuickJS interpreter debug support"
	default n
	---help---
		Enable this if you want js debugger support.

config INTERPRETERS_QUICKJS_CONFIG_TOOL
	bool "QuickJS interpreter config tool support"
	default n
	---help---
		Enable this if you want js config tool support.

config INTERPRETERS_QUICKJS_EXPORT_API
	bool "Export API to WAMR"
	default n

config INTERPRETERS_QUICKJS_HEAPDUMP
	bool "Enable QUICKJS_HEAPDUMP"
	select INTERPRETERS_QUICKJS_DEBUG
	default n

config INTERPRETERS_QUICKJS_CPUPROFILING
	bool "Enable QUICKJS_CPUPROFILING"
	default n

config INTERPRETERS_QUICKJS_TEST
	bool "Enable QuickJS test"
	default n

endif # INTERPRETERS_QUICKJS
```

## testing/opus_ramtest/Kconfig
```kconfig
#
# For a description of the syntax of this configuration file,
# see the file kconfig-language.txt in the NuttX tools repository.
#

config TESTING_OPUS_RAMTEST
	tristate "opus decode ram test"
	depends on LIB_OPUS && CODECS_HASH_MD5 && NETUTILS_CODECS && LIB_OPUS_DEMO
	default n

if TESTING_OPUS_RAMTEST

config TESTING_OPUS_RAMTEST_PROGNAME
	string "Program name"
	default "opus_ramtest"
	---help---
		This is the name of the program that will be used when the NSH ELF
		program is installed.

config TESTING_OPUS_RAMTEST_PRIORITY
	int "the priority of this command"
	default 100

config TESTING_OPUS_RAMTEST_STACKSIZE
	int "the stack size of this command"
	default 4096

endif
```

## testing/schedtest/Kconfig
```kconfig
#
# For a description of the syntax of this configuration file,
# see the file kconfig-language.txt in the NuttX tools repository.
#

config TESTING_SCHEDTEST
	tristate "Sched test"
	default n
	depends on WQUEUE_NOTIFIER
	---help---
		Enable the Sched test

		For all tests to be successful, you need to enable
		CONFIG_SCHEDTEST in addition.

if TESTING_SCHEDTEST

config TESTING_SCHEDTEST_PROGNAME
	string "schedtest"
	default "schedtest"
	---help---
		This is the name of the program that will be used when the NSH ELF
		program is installed.

config TESTING_SCHEDTEST_PRIORITY
	int "Scanftest task priority"
	default 100

config TESTING_SCHEDTEST_STACKSIZE
	int "Schedtest stack size"
	default DEFAULT_TASK_STACKSIZE

endif
```
