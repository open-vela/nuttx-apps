## examples/avdemo/Kconfig
```kconfig
#
# For a description of the syntax of this configuration file,
# see the file kconfig-language.txt in the NuttX tools repository.
#

menuconfig EXAMPLES_AVDEMO
	tristate "Camera + microphone LVGL demo (avdemo)"
	default n
	depends on GRAPHICS_LVGL
	---help---
		LVGL demo showing a live MIPI-CSI camera view with a microphone
		waveform overlay.  Expects /dev/video0 (RGB565 capture) and
		/dev/audio/pcm_in0 (PCM capture); each is optional at runtime.

if EXAMPLES_AVDEMO

config EXAMPLES_AVDEMO_PRIORITY
	int "avdemo task priority"
	default 100

config EXAMPLES_AVDEMO_STACKSIZE
	int "avdemo stack size"
	default 32768

config EXAMPLES_AVDEMO_INPUT_DEVPATH
	string "Touchscreen device path"
	default "/dev/input0"
	depends on INPUT_TOUCHSCREEN

config EXAMPLES_AVDEMO_VIDEO_DEVPATH
	string "Video capture device path"
	default "/dev/video0"

config EXAMPLES_AVDEMO_AUDIO_DEVPATH
	string "Audio capture device path"
	default "/dev/audio/pcm_in0"

endif # EXAMPLES_AVDEMO
```

## examples/camcap/Kconfig
```kconfig
config EXAMPLES_CAMCAP
	tristate "Camera frame capture to file"
	default n
	depends on VIDEO_STREAM
	---help---
		Capture a single frame from /dev/video0 and save to file.
		Supports raw RGB565 output. JPEG output via /dev/jpeg when
		ESP32-P4 hardware encoder is available.

if EXAMPLES_CAMCAP
config EXAMPLES_CAMCAP_PROGNAME
	string "Program name"
	default "camcap"

config EXAMPLES_CAMCAP_PRIORITY
	int "camcap task priority"
	default 100

config EXAMPLES_CAMCAP_STACKSIZE
	int "camcap stack size"
	default 16384
endif
```

## examples/campilot/Kconfig
```kconfig
#
# For a description of the syntax of this configuration file,
# see the file kconfig-language.txt in the NuttX tools repository.
#

config EXAMPLES_CAMPILOT
	bool "campilot MiMo AI example"
	default n
	select MIMO_CLIENT
	---help---
		NSH "campilot" command for MiMo AI interaction.
		Supports:
		  campilot once [prompt]  - capture image, send to vision API
		  campilot text <message> - send text query

if EXAMPLES_CAMPILOT

config EXAMPLES_CAMPILOT_PROGNAME
	string "Program name"
	default "campilot"

config EXAMPLES_CAMPILOT_PRIORITY
	int "Task priority"
	default 100

config EXAMPLES_CAMPILOT_STACKSIZE
	int "Stack size"
	default 32768

config EXAMPLES_CAMPILOT_AUTOTEST
	bool "Auto-run campilot test at boot"
	default n
	---help---
		Automatically spawn a campilot auto-test task from the board's
		bringup code (esp32p4-function-ev-board), which configures the
		network and sends a text query to MiMo once at boot.

		Disable this when the auto-test interferes with interactive NSH
		use. The "campilot" command itself remains available regardless
		of this setting.

config EXAMPLES_CAMPILOT_FEISHU
	bool "Push analysis result to Feishu"
	default n
	select FEISHU_NOTIFY
	---help---
		After each vision/text analysis, push the result text to a Feishu
		group chat via feishu_notify. The target chat_id is read from
		board_secrets.h (BOARD_FEISHU_CHAT_ID) or FEISHU_NOTIFY_CHAT_ID.

config EXAMPLES_CAMPILOT_UI
	bool "LVGL three-screen card UI"
	default n
	depends on GRAPHICS_LVGL
	select LV_USE_NUTTX
	select LV_FONT_MONTSERRAT_24
	select LV_FONT_MONTSERRAT_48
	select ESP32P4_GT911_SHIM
	---help---
		Build the LVGL three-screen card UI (camera preview, AI result,
		voice dialog) with left/right swipe navigation and tap detection,
		driven by the board-level GT911 polling shim.

		This only adds the UI sources (ui_state_machine.c, ui_lvgl.c) to the
		campilot binary; wiring ui_lvgl_main() into campilot_main.c is a
		separate bring-up step. The GT911 shim and the LVGL NuttX framebuffer
		driver are selected automatically.

endif # EXAMPLES_CAMPILOT
```

## examples/face_detection/Kconfig
```kconfig
#
# For a description of the syntax of this configuration file,
# see the file kconfig-language.txt in the NuttX tools repository.
#

config EXAMPLES_FACE_DETECTION
	tristate "Frontal Face Detection example (TFLite Micro)"
	default n
	depends on TFLITEMICRO
	---help---
		Frontal face detection demo using TensorFlow Lite Micro.
		Runs a MediaPipe BlazeFace short-range INT8 model (128x128 RGB,
		SSD with 896 anchors + 6 face keypoints) and reports whether a
		face is squarely facing the camera, judged from the eye and nose
		keypoints.

if EXAMPLES_FACE_DETECTION

config EXAMPLES_FACE_DETECTION_PROGNAME
	string "Program name"
	default "face_detection"
	---help---
		This is the name of the program that will be used when the NSH ELF
		program is installed.

config EXAMPLES_FACE_DETECTION_PRIORITY
	int "Face Detection task priority"
	default 100

config EXAMPLES_FACE_DETECTION_STACKSIZE
	int "Face Detection task stack size"
	default 32768
	---help---
		Task stack size. The TFLite Micro tensor arena is a static global,
		not on the stack, so this only covers the task itself.

config EXAMPLES_FACE_DETECTION_ARENA_SIZE
	int "TFLite Micro tensor arena size (bytes)"
	default 524288
	---help---
		Size of the static tensor arena for the BlazeFace model. The app
		prints arena_used_bytes at startup; tune this down to the reported
		value (rounded up) to save RAM, or up if AllocateTensors fails.

endif
```

## examples/jpegenc/Kconfig
```kconfig
config EXAMPLES_JPEGENC
	tristate "JPEG M2M encode one RGB565 frame to file"
	default n
	depends on VIDEO_STREAM
	---help---
		Encode a single RGB565 frame (/data/capture.rgb565) to JPEG
		(/data/capture.jpg) using the ESP32-P4 hardware JPEG encoder
		via /dev/video1 (V4L2 M2M).

if EXAMPLES_JPEGENC
config EXAMPLES_JPEGENC_PROGNAME
	string "Program name"
	default "jpegenc"

config EXAMPLES_JPEGENC_PRIORITY
	int "jpegenc task priority"
	default 100

config EXAMPLES_JPEGENC_STACKSIZE
	int "jpegenc stack size"
	default 16384
endif
```

## examples/ls_driver_test/Kconfig
```kconfig
config EXAMPLES_LS_DRIVER_TEST
	tristate "Loongson Driver Test"
	default n
	---help---
		Enable the Loongson driver test application

if EXAMPLES_LS_DRIVER_TEST

config EXAMPLES_LS_DRIVER_TEST_PROGNAME
	string "Program name"
	default "ls_driver_test"
	---help---
		This is the name of the program that will be used when the NSH ELF
		program is installed.

config EXAMPLES_LS_DRIVER_TEST_PRIORITY
	int "Test task priority"
	default 100

config EXAMPLES_LS_DRIVER_TEST_STACKSIZE
	int "Test stack size"
	default DEFAULT_TASK_STACKSIZE

config EXAMPLES_LS_DRIVER_TEST_HEAPSIZE
	int "Test heap size"
	depends on MM_TASK_HEAP
	default MM_TASK_HEAP_DEFAULT_SIZE

endif
```

## examples/lvgldemo/Kconfig
```kconfig
#
# For a description of the syntax of this configuration file,
# see the file kconfig-language.txt in the NuttX tools repository.
#

menuconfig EXAMPLES_LVGLDEMO
	tristate "LVGL Demo"
	default n
	depends on GRAPHICS_LVGL
	---help---
		Enable build the Light and Versatile Graphics Library Demo programs

if EXAMPLES_LVGLDEMO

config EXAMPLES_LVGLDEMO_PRIORITY
	int "lvgldemo task priority"
	default 100

config EXAMPLES_LVGLDEMO_STACKSIZE
	int "lvgldemo stack size"
	default 32768

config EXAMPLES_LVGLDEMO_INPUT_DEVPATH
	string "Touchscreen device path"
	default "/dev/input0"
	depends on INPUT_TOUCHSCREEN
	---help---
		The path to the touchscreen device. Default: "/dev/input0"

config EXAMPLES_LVGLDEMO_SIGNBRIDGE
	bool "SignBridge UI with boot screen and camera preview"
	default n
	---help---
		Replace the default LVGL demo screen with the SignBridge UI:
		boot screen (openvela logo), recognition result cards and a
		SC2336 camera preview through the ESP32-P4 MIPI-CSI driver.
		Enable only on targets providing the esp32p4 MIPI-CSI driver
		(e.g. esp32p4-function-ev-board).

endif # EXAMPLES_LVGLDEMO
```

## examples/mimonet/Kconfig
```kconfig
#
# For a description of the syntax of this configuration file,
# see the file kconfig-language.txt in the NuttX tools repository.
#

config EXAMPLES_MIMONET
	tristate "MiMo API network self-test"
	default n
	depends on NET_TCP && NETDB_DNSCLIENT && CRYPTO_MBEDTLS
	---help---
		Staged connectivity self-test against the Xiaomi MiMo API:
		DNS resolution, TCP connect, TLS handshake and an HTTPS GET.
		Each stage reports PASS or FAIL independently so that a failure
		points directly at the offending layer.

if EXAMPLES_MIMONET

config EXAMPLES_MIMONET_PROGNAME
	string "Program name"
	default "mimonet"

config EXAMPLES_MIMONET_PRIORITY
	int "mimonet task priority"
	default 100

config EXAMPLES_MIMONET_STACKSIZE
	int "mimonet stack size"
	default 16384
	---help---
		The TLS handshake needs a large stack for certificate and
		key exchange buffers. Do not reduce below 12288.

endif
```

## examples/person_detection/Kconfig
```kconfig
#
# For a description of the syntax of this configuration file,
# see the file kconfig-language.txt in the NuttX tools repository.
#

config EXAMPLES_PERSON_DETECTION
	tristate "Person Detection example (TFLite Micro)"
	default n
	depends on TFLITEMICRO
	---help---
		Person detection demo using TensorFlow Lite Micro.
		Runs a MobileNet V1 based INT8 quantized model (96x96 grayscale)
		to detect whether a person is present in an image.

if EXAMPLES_PERSON_DETECTION

config EXAMPLES_PERSON_DETECTION_PROGNAME
	string "Program name"
	default "person_detection"
	---help---
		This is the name of the program that will be used when the NSH ELF
		program is installed.

config EXAMPLES_PERSON_DETECTION_PRIORITY
	int "Person Detection task priority"
	default 100

config EXAMPLES_PERSON_DETECTION_STACKSIZE
	int "Person Detection task stack size"
	default 32768
	---help---
		Stack size must be large enough for the TFLite Micro tensor arena
		(136KB) plus model inference overhead. Default 16KB is for the
		task stack only; the tensor arena is allocated as a static global.

endif
```

## feishu_notify/Kconfig
```kconfig
#
# For a description of the syntax of this configuration file,
# see the file kconfig-language.txt in the NuttX tools repository.
#

config FEISHU_NOTIFY
	bool "Feishu (Lark) notification client"
	default n
	select NETUTILS_CJSON
	---help---
		Enables a minimal Feishu notification client that sends text
		messages to a Feishu group chat via the Feishu OpenAPI
		(tenant_access_token + im/v1/messages) over HTTPS/TLS.

if FEISHU_NOTIFY

config FEISHU_NOTIFY_USE_BOARD_SECRETS
	bool "Use board_secrets.h for Feishu credentials"
	default y
	---help---
		When enabled, App ID, App Secret, and default chat_id are read from
		<arch/board/board_secrets.h> instead of the Kconfig values below.
		This keeps credentials out of the public defconfig.

config FEISHU_NOTIFY_APP_ID
	string "Feishu App ID (fallback)"
	default ""
	---help---
		Fallback App ID when FEISHU_NOTIFY_USE_BOARD_SECRETS is disabled.

config FEISHU_NOTIFY_APP_SECRET
	string "Feishu App Secret (fallback)"
	default ""
	---help---
		Fallback App Secret when FEISHU_NOTIFY_USE_BOARD_SECRETS is disabled.

config FEISHU_NOTIFY_CHAT_ID
	string "Default Feishu chat_id (fallback)"
	default ""
	---help---
		Fallback target chat_id when FEISHU_NOTIFY_USE_BOARD_SECRETS is
		disabled. Used by "feishu test" and campilot auto-push.

config FEISHU_NOTIFY_OPEN_ID
	string "Default Feishu open_id (fallback)"
	default ""
	---help---
		Fallback DM recipient open_id when FEISHU_NOTIFY_USE_BOARD_SECRETS is
		disabled. Used by "feishu dm" and campilot auto-push (direct message).

config FEISHU_NOTIFY_PROGNAME
	string "Program name"
	default "feishu"

config FEISHU_NOTIFY_PRIORITY
	int "Task priority"
	default 100

config FEISHU_NOTIFY_STACKSIZE
	int "Stack size"
	default 8192

endif # FEISHU_NOTIFY
```

## mimo_client/Kconfig
```kconfig
#
# For a description of the syntax of this configuration file,
# see the file kconfig-language.txt in the NuttX tools repository.
#

config MIMO_CLIENT
	bool "MiMo multimodal client library"
	default n
	select NETUTILS_CJSON
	---help---
		Enables the MiMo multimodal client library for communicating
		with the Xiaomi MiMo AI API. Supports text and vision
		modalities over HTTPS/TLS.

if MIMO_CLIENT

config MIMO_CLIENT_USE_BOARD_SECRETS
	bool "Use board_secrets.h for API credentials"
	default y
	---help---
		When enabled, API key, host, and port are read from
		<arch/board/board_secrets.h> instead of Kconfig values.
		This keeps credentials out of the public defconfig.

config MIMO_CLIENT_API_KEY
	string "MiMo API Key (fallback)"
	default ""
	---help---
		Fallback API key when MIMO_CLIENT_USE_BOARD_SECRETS is disabled.

config MIMO_CLIENT_HOST
	string "MiMo API Host"
	default "token-plan-cn.xiaomimimo.com"

config MIMO_CLIENT_PORT
	string "MiMo API Port"
	default "443"

endif # MIMO_CLIENT
```

## system/ls2k0300_power/Kconfig
```kconfig
#
# For a description of the syntax of this configuration file,
# see the file kconfig-language.txt in the NuttX tools repository.
#

config SYSTEM_LS2K0300_POWER
	bool "LS2K0300 power management commands"
	default n
	depends on ARCH_LOONGARCH
	---help---
		Enable LS2K0300 specific power management commands (reboot/poweroff)

if SYSTEM_LS2K0300_POWER

config SYSTEM_LS2K0300_REBOOT
	bool "LS2K0300 reboot command"
	default y
	---help---
		Enable the reboot command for LS2K0300 board.
		This command writes 1 to register 0x16124000 to trigger reboot.

config SYSTEM_LS2K0300_REBOOT_PROGNAME
	string "Reboot program name"
	default "reboot"
	---help---
		This is the name of the program that will be used when the NSH
		program is installed.

config SYSTEM_LS2K0300_REBOOT_PRIORITY
	int "Reboot task priority"
	default 100

config SYSTEM_LS2K0300_REBOOT_STACKSIZE
	int "Reboot stack size"
	default DEFAULT_TASK_STACKSIZE

config SYSTEM_LS2K0300_POWEROFF
	bool "LS2K0300 poweroff command"
	default y
	---help---
		Enable the poweroff command for LS2K0300 board.
		This command writes 0x3c00 to register 0x16124000+0x14 to power off.

config SYSTEM_LS2K0300_POWEROFF_PROGNAME
	string "Poweroff program name"
	default "poweroff"
	---help---
		This is the name of the program that will be used when the NSH
		program is installed.

config SYSTEM_LS2K0300_POWEROFF_PRIORITY
	int "Poweroff task priority"
	default 100

config SYSTEM_LS2K0300_POWEROFF_STACKSIZE
	int "Poweroff stack size"
	default DEFAULT_TASK_STACKSIZE

endif
```
